## drivers/vfio/pci/nvme/Kconfig
```kconfig
# SPDX-License-Identifier: GPL-2.0-only
config NVME_VFIO_PCI
	tristate "VFIO support for NVMe PCI devices"
	depends on VFIO_PCI_CORE
	help
	  This provides generic VFIO PCI support for NVMe device
	  using the VFIO framework.

	  If you don't know what to do here, say N.
```
